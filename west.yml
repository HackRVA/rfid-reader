## west.yml
```yaml
# SPDX-License-Identifier: MIT

manifest:
  remotes:
    - name: zephyrproject-rtos
      url-base: https://github.com/zephyrproject-rtos
  projects:
    - name: zephyr
      remote: zephyrproject-rtos
      revision: main
      import:
        name-blocklist:
          - canopennode
          - hal_altera
          - hal_atmel
          - hal_espressif
          - hal_gigadevice
          - hal_infineon
          - hal_microchip
          - hal_nordic
          - hal_nuvotion
          - hal_openisa
          - hal_quicklogic
          - hal_renesas
          - hal_rpi_pico
          - hal_silabs
          - hal_st
          - hal_stm32
          - hal_telink
          - hal_ti
          - hal_wurthelektronik
          - hal_xtensa
          - nrf_hw_models
          - open-amp
          - openthread
          - trusted-firmware-a
          - trusted-firmware-m
          - tf-m-tests
  self:
    path: rfid-reader
```
